## esp-network-support/Kconfig
```kconfig
menu "Network Configuration"

    config NETWORK_ENABLE_SNTP
        bool "Enable SNTP"
        default n

    config NETWORK_WIFI_CONNECT_ATTEMPTS
        int "WiFi connection attempts"
        default 5

    config NETWORK_WIFI_MAX_TX_POWER
        int "WiFi max transmission power"
        default 0

        help
            When set to 0, the default will be used. If you want a sane "low"
            power setting, 44 will suffice. This translates to 11 Db.

    config NETWORK_RECEIVE_TIMEOUT
        int "Network receive timeout in ms"
        default 15000

endmenu
```

## esp-network-support/sdkconfig.defaults
```kconfig
# Allow MBEDTLS to use PSRAM

CONFIG_MBEDTLS_DEFAULT_MEM_ALLOC=y

# Required for WiFI

CONFIG_DIAG_USE_EXTERNAL_LOG_WRAP=y

# Enable SPIRAM for WiFi

CONFIG_SPIRAM_TRY_ALLOCATE_WIFI_LWIP=y
```

## esp-sensor-support/Kconfig
```kconfig
menu "Sensor Configuration"

    config SEN0626_GESTURE_THRESHOLD
        int "SEN0626 gesture score threshold (0-100)"
        range 0 100
        default 60

    config SEN0626_FACE_SCORE_THRESHOLD
        int "SEN0626 face score threshold (0-100)"
        range 0 100
        default 60

    config SEN0626_DETECT_THRESHOLD
        int "SEN0626 detection threshold (0-100)"
        range 0 100
        default 100

endmenu
```

## esp-status-led-support/Kconfig
```kconfig
menu "Status Led Configuration"

    config STATUS_LED_WS2812_PIN
        int "Status led pin for the WS2812"
        default -1

endmenu
```
